/**
 * @cliArgs --board "/ti/boards/MSP_EXP432P401R" --product "simplelink_msp432p4_sdk@3.40.01.02"
 * @versions {"tool":"1.14.0+2667"}
 */

/**
 * Import the modules used in this configuration.
 */
const GPIO  = scripting.addModule("/ti/drivers/GPIO");
const GPIO1 = GPIO.addInstance();
const GPIO2 = GPIO.addInstance();
const GPIO3 = GPIO.addInstance();
const GPIO4 = GPIO.addInstance();
const GPIO5 = GPIO.addInstance();
const GPIO6 = GPIO.addInstance();
const GPIO7 = GPIO.addInstance();
const GPIO8 = GPIO.addInstance();
const GPIO9 = GPIO.addInstance();
const I2C   = scripting.addModule("/ti/drivers/I2C", {}, false);
const I2C1  = I2C.addInstance();
const RTOS  = scripting.addModule("/ti/drivers/RTOS");
const SD    = scripting.addModule("/ti/drivers/SD", {}, false);
const SD1   = SD.addInstance();
const SPI   = scripting.addModule("/ti/drivers/SPI", {}, false);
const SPI1  = SPI.addInstance();
const UART  = scripting.addModule("/ti/drivers/UART", {}, false);
const UART1 = UART.addInstance();
const UART2 = UART.addInstance();

/**
 * Write custom configuration values to the imported modules.
 */
GPIO1.$hardware = system.deviceData.board.components.LED1_RED;
GPIO1.$name     = "CONFIG_GPIO_LED_0";

GPIO2.$hardware = system.deviceData.board.components.LED2_RED;
GPIO2.$name     = "CONFIG_GPIO_LED_1";

GPIO3.$name     = "CONFIG_GPIO_LED_2";
GPIO3.$hardware = system.deviceData.board.components.LED2_GREEN;

GPIO4.$name     = "CONFIG_GPIO_LED_3";
GPIO4.$hardware = system.deviceData.board.components.LED2_BLUE;

GPIO5.$hardware = system.deviceData.board.components.S2;
GPIO5.$name     = "CONFIG_GPIO_BUTTON_1";

GPIO6.$hardware = system.deviceData.board.components.S1;
GPIO6.$name     = "CONFIG_GPIO_BUTTON_0";

GPIO7.$name              = "CONFIG_SD_LED_BLUE";
GPIO7.mode               = "Output";
GPIO7.initialOutputState = "High";
GPIO7.gpioPin.$assign    = "boosterpack.37";

GPIO8.mode               = "Output";
GPIO8.initialOutputState = "High";
GPIO8.$name              = "CONFIG_SD_LED_GREEN";
GPIO8.gpioPin.$assign    = "boosterpack.39";

GPIO9.$name              = "CONFIG_SD_LED_RED";
GPIO9.mode               = "Output";
GPIO9.initialOutputState = "High";
GPIO9.gpioPin.$assign    = "boosterpack.40";

I2C1.$name = "CONFIG_I2C_0";

const Power                   = scripting.addModule("/ti/drivers/Power", {}, false);
Power.performanceLevel3.$name = "ti_drivers_power_PowerMSP432PerfLevels0";
Power.performanceLevel2.$name = "ti_drivers_power_PowerMSP432PerfLevels1";
Power.performanceLevel1.$name = "ti_drivers_power_PowerMSP432PerfLevels2";
Power.performanceLevel0.$name = "ti_drivers_power_PowerMSP432PerfLevels3";


SD1.$name                       = "CONFIG_SD_0";
SD1.useFatFS                    = true;
SD1.slaveSelect.$name           = "CONFIG_GPIO_0";
SD1.slaveSelect.gpioPin.$assign = "boosterpack.18";

SPI1.$name      = "CONFIG_SPI_0";
SD1.spiInstance = SPI1;

UART1.$name     = "CONFIG_UART_0";
UART1.$hardware = system.deviceData.board.components.XDS110UART;

UART2.$name              = "CONFIG_UART_1";
UART2.dataDirection      = "Send Only";
UART2.baudRates          = [921600];
UART2.uart.txPin.$assign = "boosterpack.4";

/**
 * Pinmux solution for unlocked pins/peripherals. This ensures that minor changes to the automatic solver in a future
 * version of the tool will not impact the pinmux you originally saw.  These lines can be completely deleted in order to
 * re-solve from scratch.
 */
GPIO1.gpioPin.$suggestSolution               = "ball.4";
GPIO2.gpioPin.$suggestSolution               = "ball.16";
GPIO3.gpioPin.$suggestSolution               = "ball.17";
GPIO4.gpioPin.$suggestSolution               = "ball.18";
GPIO5.gpioPin.$suggestSolution               = "ball.8";
GPIO6.gpioPin.$suggestSolution               = "ball.5";
I2C1.i2c.$suggestSolution                    = "EUSCI_B1";
I2C1.i2c.sdaPin.$suggestSolution             = "boosterpack.10";
I2C1.i2c.sclPin.$suggestSolution             = "boosterpack.9";
RTOS.timer0.resource.$suggestSolution        = "Timer_A0";
SPI1.spi.$suggestSolution                    = "EUSCI_B0";
SPI1.spi.sclkPin.$suggestSolution            = "boosterpack.7";
SPI1.spi.misoPin.$suggestSolution            = "boosterpack.14";
SPI1.spi.mosiPin.$suggestSolution            = "boosterpack.15";
SPI1.spi.dmaRxChannel.$suggestSolution       = "DMA_CH1";
SPI1.spi.dmaTxChannel.$suggestSolution       = "DMA_CH0";
SPI1.spi.dmaInterruptNumber.$suggestSolution = "DMA_INT0";
UART1.uart.$suggestSolution                  = "EUSCI_A0";
UART1.uart.txPin.$suggestSolution            = "ball.7";
UART1.uart.rxPin.$suggestSolution            = "ball.6";
UART2.uart.$suggestSolution                  = "EUSCI_A1";
